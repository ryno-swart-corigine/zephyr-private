## boards/riscv/eswin_e330/Kconfig.board
```kconfig
# Copyright (c) 2022 ESWIN Co,ltd. 
# SPDX-License-Identifier: Apache-2.0

config BOARD_ESWIN_E330
	bool "ESWIN E330 Minic"
	depends on SOC_ESWIN_E330
```

## boards/riscv/eswin_e330/Kconfig.defconfig
```kconfig
# SPDX-License-Identifier: Apache-2.0

if BOARD_ESWIN_E330

config BOARD
	default "eswin_e330"

config SYS_CLOCK_TICKS_PER_SEC
	default 128

config SYS_CLOCK_HW_CYCLES_PER_SEC
	default 4000000

config THREAD_LOCAL_STORAGE
	default y

endif # BOARD_ESWIN_E330
```

## boards/riscv/eswin_e330/eswin_e330_defconfig
```kconfig
# Copyright (c) 2022 ESWIN Co,ltd. 
# SPDX-License-Identifier: Apache-2.0

# SoC and Board
CONFIG_SOC_SERIES_ESWIN_E330=y
CONFIG_SOC_ESWIN_E330=y
CONFIG_BOARD_ESWIN_E330=y

# TICK
CONFIG_RISCV_MACHINE_TIMER=y
CONFIG_SYS_CLOCK_TICKS_PER_SEC=100

# PLIC
CONFIG_PLIC=n

# CLIC
CONFIG_ESWIN_CLIC=y
CONFIG_CLIC_MAX_INT_CTRL_BITS=5
CONFIG_CLIC_INT_CTRL_BITS=3

CONFIG_XIP=n

# FPU
CONFIG_FLOAT_HARD=y

# Driver
CONFIG_SERIAL=y
CONFIG_CONSOLE=y
CONFIG_UART_NS16550=y
CONFIG_UART_CONSOLE=y
CONFIG_UART_NS16550_ACCESS_WORD_ONLY=y
CONFIG_UART_USE_RUNTIME_CONFIGURE=n
CONFIG_UART_INTERRUPT_DRIVEN=y
CONFIG_UART_NS16550_SYNOPSYS_DW_APB_UART=y

# PMP
CONFIG_RISCV_PMP=y
CONFIG_PMP_GRANULARITY=8
CONFIG_PMP_SLOTS=16

# OUTPUT
CONFIG_OUTPUT_DISASSEMBLY=y
```

## drivers/counter/Kconfig.dw_apb
```kconfig
# Counter and timer configuration options

# Copyright (c) 2022 Jerry Chai <chaizhiyong@eswin.com>
# SPDX-License-Identifier: Apache-2.0

config TIMER_DW_APB
	bool "Synopsys DesignWare APB Timer driver"
	help
	  The timers (TMR) present in the platform are used as timers.
	  This option enables the support for the timers.
```

## drivers/interrupt_controller/Kconfig.eswin
```kconfig
# Eswin Core local interrupt-controller configuration

# Copyright (c) 2022 ESWIN Co,ltd.
# SPDX-License-Identifier: Apache-2.0

DT_COMPAT_ESWIN_CLIC = eswin,clic

config ESWIN_CLIC
	bool "Eswin Core Local Interrupt Controller (CLIC)"
	default $(dt_compat_enabled,$(DT_COMPAT_ESWIN_CLIC))
	help
	  Interrupt controller for Eswin SoC core.

config CLIC_MAX_INT_CTRL_BITS
	int "max nlbits for eswin clic"
	default 7
	help
	  Set nlbits max value for ciccfg registers.

config CLIC_INT_CTRL_BITS
	int "nlbits value for eswin clic"
	default 7
	help
	  Set current nlbits value for ciccfg registers.
	  
```

## dts/bindings/interrupt-controller/eswin,clic.yaml
```yaml
# Copyright (c) 2018, ESWIN Inc.
# SPDX-License-Identifier: Apache-2.0

description: Eswin Core Interrupt Controller

compatible: "eswin,clic"

include: [interrupt-controller.yaml, base.yaml]

properties:
  reg:
    required: true

interrupt-cells:
  - irq
  - flags
```

## dts/bindings/timer/eswin,machine-timer.yaml
```yaml
# Copyright (c) 2022 Nordic Semiconductor ASA
# SPDX-License-Identifier: Apache-2.0

description: ESWIN RISC-V Core-Local Interruptor.

compatible: "eswin,machine-timer"

include: base.yaml

properties:
  reg:
    required: true
```

## soc/riscv/eswin/Kconfig
```kconfig
# Copyright (c) 2022 ESWIN Co,ltd. 
# SPDX-License-Identifier: Apache-2.0

config SOC_FAMILY_ESWIN
	bool

if SOC_FAMILY_ESWIN

config SOC_FAMILY
	string
	default "eswin"

source "soc/riscv/eswin/*/Kconfig.soc"

endif # SOC_FAMILY_ESWIN
```

## soc/riscv/eswin/Kconfig.soc
```kconfig
# Copyright (c) 2022 ESWIN Co,ltd. 
# SPDX-License-Identifier: Apache-2.0

source "soc/riscv/eswin/*/Kconfig.series"
```

## soc/riscv/eswin/e330/Kconfig.defconfig.e330
```kconfig
# Copyright (c) 2022 ESWIN Co,ltd.
# SPDX-License-Identifier: Apache-2.0

config SOC
	default "e330" if SOC_ESWIN_E330

config RISCV_TRAP_HANDLER_ALIGNMENT
	default 64
```

## soc/riscv/eswin/e330/Kconfig.series
```kconfig
# ESWIN E330 SOC implementation

# Copyright (c) 2022 ESWIN Co,ltd.
# SPDX-License-Identifier: Apache-2.0

config SOC_SERIES_ESWIN_E330
	bool "ESWIN E330 series SoC implementation"
	select RISCV
	select RISCV_PRIVILEGED
    select DT_HAS_ESWIN_MACHINE_TIMER_ENABLED
	select CPU_HAS_FPU
	select SOC_FAMILY_ESWIN
	help
	  Enable support for ESWIN E330 series SOC
```

## soc/riscv/eswin/e330/Kconfig.soc
```kconfig
# ESWIN E330 SOC configuration options

# Copyright (c) 2022 ESWIN Co,ltd.
# SPDX-License-Identifier: Apache-2.0

choice
	prompt "ESWIN E330 SOC implementation"
	depends on SOC_SERIES_ESWIN_E330

config SOC_ESWIN_E330
	bool "ESWIN 330"
	select ATOMIC_OPERATIONS_C
	select INCLUDE_RESET_VECTOR
	select CPU_HAS_FPU_DOUBLE_PRECISION
	select RISCV_ISA_RV32I
	select RISCV_ISA_EXT_M
	select RISCV_ISA_EXT_A
	select RISCV_ISA_EXT_C
	select RISCV_ISA_EXT_B
	select RISCV_ISA_EXT_P
	select RISCV_ISA_EXT_ZICOND
	select PMP_NO_NA4 if RISCV_PMP
	# e330: G=1(pmp granularity=2^(1+2)=8),not support NA4

endchoice
```
