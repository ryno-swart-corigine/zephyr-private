/* Copyright (c) 2022 ESWIN Co,ltd. */
/* SPDX-License-Identifier: Apache-2.0 */

/dts-v1/;

#include <eswin/e330.dtsi>

/ {
	model = "Eswin,e330";
	compatible = "Eswin,e330";

	chosen {
		zephyr,console = &uart0;
		zephyr,shell-uart = &uart0;

		/* Use ddr mem as SRAM by default */
		zephyr,sram = &ddr;
	};
};

&uart0 {
	status = "okay";
	current-speed = <57600>;
};

&mtimer {
    status = "okay";
};


